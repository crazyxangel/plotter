#include <Arduino.h>

#pragma region //all variables
#pragma region //x variables
int stepperx = DD2;   //the step pin of the X axis stepper pulse 1 for a step
int xdir = DD3;       //the direction pin of the X axis stepper set to 1 or 0 for diffirent directions
int xref = 0;         //reference value to compare with to determine wether or not you have to step left or right
int deltax = 0;       //value when refferncing xsteps with xref => this value gets send to the step method
#pragma endregion

#pragma region //y variables
int steppery = DD4;   //the step pin of the Y axis stepper pulse 1 for a step
int ydir = DD5;       //the direction pin of the Y axis stepper set to 1 or 0 for diffirent directions
int yref = 0;         //reference value to compare with to determine wether or not you have to step left or right
int deltay = 0;       //value when refferncing xsteps with xref => this value gets send to the step method
#pragma endregion

#pragma region //x steps array
//the steps X needs to take for each time frame calculated with python script
int xsteps[] = {7, 7, 7, 7, 7, 7, 7, 7, 7, 7, 7, 7, 7,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 169, 168};
#pragma endregion

#pragma region //y steps array
//the steps Y needs to take for each time frame calculated with python script
int ysteps[] = {15, 16, 17, 18, 19, 20, 21, 22, 23, 23, 24, 25, 26,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 238, 238};
#pragma endregion

int timeframe = 0;
#pragma endregion

void setup() 
{
  //set bits in ddrd register (datadirection register) to 1 for output 
  DDRD |= 1 << stepperx;
  DDRD |= 1 << xdir;
  DDRD |= 1 << steppery;
  DDRD |= 1 << ydir;
}

void loop() 
{
  deltax = xsteps[timeframe]-xref;
  deltay = ysteps[timeframe]-xref;
  step(deltax,deltay);
  delay(20);
  timeframe ++;
}


void step(int x, int y)
{
  #pragma region // check positivity of x and y to determine direction 
  if (x > 0)
    PORTD |= 1 << xdir;
  else if (x < 0)
    PORTD &= ~(1 << xdir);
  if (y > 0)
    PORTD |= 1 << ydir;
  else if (y < 0)
    PORTD &= ~(1 << ydir);
  #pragma endregion

  while (x > 0 || y > 0)
  {  
    if (x = 1)
      PORTD |= 1 << stepperx;
      x--;
    if (y = 1)
      PORTD |= 1 << steppery;
      y--;
    delay(50);
      PORTD &= ~(1 << stepperx);
      PORTD &= ~(1 << steppery);
  }
  
  

}
/*
X = 0 set entire byte
X |= 1 << 5 set specified bit
X &= ~(1 << 1) clear specified bit
*/